## sdkconfig.defaults
```kconfig
CONFIG_IDF_TARGET_ESP32=y
CONFIG_ESPTOOLPY_FLASHSIZE_8MB=y
CONFIG_PARTITION_TABLE_CUSTOM=y
CONFIG_PARTITION_TABLE_CUSTOM_FILENAME="partitions.csv"

CONFIG_SPIRAM=y
CONFIG_SPIRAM_MODE_OCT=y
CONFIG_SPIRAM_SPEED_80M=y
CONFIG_SPIRAM_USE_MALLOC=y
CONFIG_SPIRAM_MALLOC_ALWAYSINTERNAL=16384
CONFIG_SPIRAM_USE_CAPS_ALLOC=y

CONFIG_ESP_DEFAULT_CPU_FREQ_MHZ_240=y
CONFIG_ESP_DEFAULT_CPU_FREQ_MHZ=240

CONFIG_BT_ENABLED=y
CONFIG_BT_BLE_ENABLED=y
CONFIG_BT_NIMBLE_ENABLED=y
CONFIG_BT_NIMBLE_ROLE_PERIPHERAL=y
CONFIG_BT_NIMBLE_ROLE_BROADCASTER=y
CONFIG_BT_NIMBLE_MAX_CONNECTIONS=1

CONFIG_WIFI_PROV_BLE_ENABLE=y
CONFIG_WIFI_PROV_SCHEME_BLE=y
CONFIG_WIFI_PROV_BLE_FORCE_ENCRYPTION=y

CONFIG_CAMERA_MODULE_M5STACK_WIDE=y
CONFIG_SCCB_CLK_FREQ=100000
CONFIG_CAMERA_DMA_BUFFER_SIZE_MAX=32768

# Disable WiFi IRAM optimizations to reduce IRAM usage (required for ESP32 with camera + WiFi + BLE)
CONFIG_ESP_WIFI_IRAM_OPT=n
CONFIG_ESP_WIFI_RX_IRAM_OPT=n
```
